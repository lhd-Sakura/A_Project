/*************************************************************************************************************
*												测试说明
*1、MCU:STC89C52RC
*2、测试频率:11.0592Mhz
*2、编程语言:C51
*2、编译环境:Keil C
*2、功能:调速运行
*************************************************************************************************************/

#include <reg52.h>

//LMD298输入控制端定义
sbit IN1 = P1^0;
sbit IN2 = P1^1;	
sbit IN3 = P1^2;	
sbit IN4 = P1^3;

sbit ENA = P1^4;	
sbit ENB = P1^5;

sbit CW = P3^0;		//正转运行按键
sbit STOP = P3^1;	//停止运行按键
sbit CCW = P3^2;	//反转运行按键
sbit ADJ = P3^3;	//调速运行按键

unsigned char CYCLE; //周期变量
unsigned char DUTY; //占空比变量,对应于调速运行时按键次数，调速时每按一次调速键速度比上次变化10%

/********************************/
/*      延时函数               */
/********************************/
void Delay(unsigned int cnt)
{
 	while(--cnt);
}
/********************************/
/*      主函数		             */
/********************************/
main()
{
	TMOD |=0x01;	//定时器设置 1ms in 12M crystal
	TH0=(65536-1000)/256; 
	TL0=(65536-1000)%256;//定时1mS 
	IE= 0x82;  		//打开中断	
	
	IN1=1;			//停止
	IN2=1;
	IN3=1;
	IN4=1;
	ENA=0;
	ENB=0;

	CYCLE=10; 	//周期10ms
	DUTY=0; 	//占空比=0

	while(1)
  	{	
	   	if(!ADJ)
		{
			Delay(15000);	//延时去抖动
			if(!ADJ)
			{	
				TR0=1;
				if(DUTY<CYCLE)	DUTY+=1;	//增加占空比
				else			DUTY=0;
				
				//这里是正转调速，反转调速可以自己试着编写
				IN1=1;			
				IN2=0;			
				ENA=0;	
				IN3=1;			
				IN4=0;			
				ENB=0;	
		 	}
		}
   }
}
/********************************/
/*      定时器0中断服务函数     */
/********************************/
void Timer0(void) interrupt 1 using 1
{
	static unsigned char Cnt;

	TH0=(65536-1000)/256; 
	TL0=(65536-1000)%256;//定时1mS 
	
	if(DUTY==CYCLE)	Cnt=CYCLE;
	else			Cnt++;
	if(Cnt==DUTY)		//高电平时间到
	{
	 	ENA = 0; 
		ENB = 0; 
	}
	if(Cnt == CYCLE)	//低电平时间到
	{
		ENA = 1; 
		ENB = 1; 
	    Cnt=0;
	}
}